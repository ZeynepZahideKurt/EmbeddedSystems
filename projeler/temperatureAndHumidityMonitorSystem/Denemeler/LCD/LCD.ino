/*
  GPIO 0 12k-13k direnç ve butonla ve EN( Resetleme butonu-12k 13k direnç tak )programlama moduna geç. önce I0 butonuna basıp sonra EN butonuna basarsan programlama moduna geçer
  GPIO1 (TX) / GPIO3 (RX) ile program at
  GPIO2 bi tane led tak wifii ye bağlandığınında ışığı söner
  GPIO15 bir buton tak wifiiye bağlanma oradaki butonla eepromdaki kullanıcı adı şifreyi değiştir
  GPIO21 SDA / GPIO22 SCL 3.3 volt

  CS/CE -> GPIO 18
  RES/RST -> GPIO 5
  A0/RS/DV -> GPIO 17
  SCL -> GPIO 16
  SDA  -> GPIO 4

*/
#include <stdio.h>
#include <string.h>

#define SCREEN_CS_Pin 18
#define SCREEN_RST_Pin 5
#define SCREEN_A0_Pin 17
#define SCREEN_SCL_Pin 16
#define  SCREEN_SDA_Pin 4
#define NOP __asm__ __volatile__ ("nop\n\t")

uint8_t counter, page, column;
uint16_t screenTempI, screenTempI2;
char arr[20];
char displayArr[40];


typedef enum {
  LEFT = 0, CENTER = 1, RIGHT = 2
} LOCATION;
typedef enum {
  INSTRUCTION = 0, DATA = 1
} TRANSMODE;

const uint8_t charArray[64][10] = { { 1, 0x00 }, /*   */
  { 1, 0xbf }, /* ! */
  { 3, 0x07, 0x00, 0x07 }, /* " */
  { 7, 0x04, 0x27, 0x3c, 0xe7, 0x3c, 0xe7, 0xbf }, /* # */
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  { 7, 0x80, 0x80, 0x80, 0x80, 0x80, 0x80, 0x80 } /* _ */
};

const uint8_t logoArray[1024] = { 0x00, 0x00, 0x00, 0x00, 0x00, 0x00, 0x00,
                                  0x00, 0x00, 0x00, 0x00, 0x00, 0x00, 0x00, 0x00, 0x00, 0x00, 0x00, 0x00,
                                  0x00, 0x00, 0x00, 0x00, 0x00, 0x00, 0x00, 0x00, 0x00, 0x00, 0x00, 0x00,
                                  0x00, 0x00, 0x00, 0x00, 0x00, 0x00, 0x00, 0x00, 0x00, 0x00, 0x00, 0x80,
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                                  0x00, 0x00, 0x00, 0x00, 0x00, 0x00, 0x00, 0x00, 0x00
                                };

const uint8_t cl[1024] = {   

0xFF, 0xFF, 0x03, 0x03,  0x03, 0x03,   0x03,  0x03,
0x03,  0x03, 0x03, 0x03, 0x03, 0x03,   0x03,  0x03,
0x03,  0x03, 0x03, 0x03, 0x03, 0x03,   0x03,  0x03,
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0xC0, 0xC0, 0xC0, 0xC0,  0xC0, 0xC0, 0xFF, 0xFF
 };

const uint8_t initialArray[13] = { 0xa2, //bias set:1/9
                                   0xa0, //ADC select:nomal,0->128
                                   0xa6, //normal/reverse  display   a6 -> normal , a7 -> reverse
                                   0xc8, //commom output mode select: reverse c8->reverse , c0->normal
                                   0xf8, //booster ratio set
                                   0x00, //booster ratio:4x
                                   0x2f, //power control set
                                   0x25, //set (Rb/Ra)
                                   0x81, //vo output voltage set
                                   0x1f, 0x42, //voltage volume =9.0v
                                   0x40, //set start line
                                   0xaf //display on
                                 };

void trans(TRANSMODE type, uint8_t command) {
  digitalWrite(SCREEN_CS_Pin, 0);

  digitalWrite(SCREEN_A0_Pin, type != INSTRUCTION);
  for (counter = 0; counter < 8; counter++) {
    
    if(((command & 0x80) == 0x80) ==1){
      digitalWrite(SCREEN_SDA_Pin, 1);
    }else{
      digitalWrite(SCREEN_SDA_Pin, 0);
    }

    digitalWrite(SCREEN_SCL_Pin, 0);
    NOP;
    digitalWrite(SCREEN_SCL_Pin, 1);
    NOP;
    digitalWrite(SCREEN_SCL_Pin, 0);
    NOP;
    command <<= 1;
  }

  digitalWrite(SCREEN_CS_Pin, HIGH);
}

void initial() {
  for (screenTempI = 0; screenTempI < 13; screenTempI++) {
    trans(INSTRUCTION, initialArray[screenTempI]);
  }
}
void setPage(uint8_t page) {
  trans(INSTRUCTION, 0xb0 + page);
}

void setColumn(uint8_t column) {
  trans(INSTRUCTION, 0x10 | (column >> 4));
  trans(INSTRUCTION, 0x00 | (column & 0x0f));
}

void clearScreen(uint8_t removeFirstPage) {
  for (page = !removeFirstPage; page < 8; page++) {
    setPage(page);
    setColumn(0);
    for (column = 0; column < 128; column++) {
      trans(DATA, 0x00);
    }
  }
}

void setScreenAndBackgroundLED(bool isOpen) {

  digitalWrite(SCREEN_A0_Pin, 0);
  digitalWrite(SCREEN_CS_Pin, 0);
  digitalWrite(SCREEN_RST_Pin, 0);
  digitalWrite(SCREEN_SCL_Pin, 0);
  digitalWrite(SCREEN_SDA_Pin, 0);

}
void initScreen() {
  setScreenAndBackgroundLED(true);
  digitalWrite(SCREEN_RST_Pin, 0);
  digitalWrite(SCREEN_RST_Pin, 1);
  initial();
  displaycl();
  //clearScreen(1);
}

void clearPage(uint8_t page) {
  setPage(page);
  setColumn(0);
  for (column = 0; column < 128; column++) {
    trans(DATA, 0x00);
  }
}

void displayChar(char array[]) {
  uint8_t size = array[0];
  for (screenTempI = 1; screenTempI < size + 1; screenTempI++) {
    trans(DATA, array[screenTempI]);
  }
  trans(DATA, 0x00);
}

void displayBigChar(char array[]) {
  for (screenTempI = 0; screenTempI < 10; screenTempI++) {
    trans(DATA, array[screenTempI]);
  }
  trans(DATA, 0x00);
}

void display(uint8_t page, char sentence[], LOCATION location, bool isClearRow) {
  if (isClearRow)
    clearPage(page);
  int16_t i;
  char temp2[20];
  uint16_t sentence_size = strlen(sentence);
  uint8_t total_column = 0;
  char letter;
  for (i = 0; i < sentence_size; i++) {
    letter = sentence[i];
    total_column += charArray[letter - 32][0];
  }
  total_column += sentence_size - 1;
  setPage(page);
 /* switch (location) {
    case LEFT:
      setColumn(128 - total_column);
      break;
    case CENTER:
      setColumn(64 - (total_column / 2));
      break;
    case RIGHT:
      setColumn(0);
      break;
    default:
      setColumn(location);
      break;
  }*/

  //int kontrol=1;  && kontrol==1
  if(location==LEFT){
    setColumn(128 - total_column);
      //  kontrol=0;
      
  }
  if(location==CENTER){
    setColumn(64 - (total_column / 2));
  }
  if(location==RIGHT){
    setColumn(0);
  }
  /*if( location== default){
    setColumn(location);
  }*/

  
  for (i = sentence_size - 1; i >= 0; i--) {
    letter = sentence[i];
    memcpy(temp2, charArray[letter - 32], charArray[letter - 32][0] + 1);
    displayChar(temp2);
  }
}

//MAX 11 KARAKTER
void displayBig(uint8_t page, char sentence[], LOCATION location) { //page: 0, 2, 4, 6
  int8_t i;
  char temp2[10];
  char letter;
  uint8_t sentence_size = strlen(sentence); //KART YOK
  uint8_t total_column = 0;
  for (i = 0; i < sentence_size; i++) {
    if (sentence[i] == ' ')
      total_column += 3;
    else
      total_column += 11;
  }
  switch (location) {
    case LEFT:
      total_column = 128 - total_column;
      break;
    case CENTER:
      total_column = 64 - (total_column / 2);
      break;
    case RIGHT:
      total_column = 0;
      break;
  }


  
  clearPage(page);
  setPage(page);
  setColumn(total_column);
  for (i = sentence_size - 1; i >= 0; i--) {
    letter = sentence[i];
    if (letter == ' ') {
      trans(DATA, 0x00);
      trans(DATA, 0x00);
      trans(DATA, 0x00);
      trans(DATA, 0x00);
    } else {
      //   memcpy(temp2, big_char_array_page_top[letter - 32], 10);
      displayBigChar(temp2);
    }
  }
  clearPage(page + 1);
  setPage(page + 1);
  setColumn(total_column);
  for (i = sentence_size - 1; i >= 0; i--) {
    letter = sentence[i];
    if (letter == ' ') {
      trans(DATA, 0x00);
      trans(DATA, 0x00);
      trans(DATA, 0x00);
      trans(DATA, 0x00);
    } else {
      //  memcpy(temp2, big_char_array_page_bottom[letter - 32], 10);
      displayBigChar(temp2);
    }
  }
}

void displayLogo() {
  for (screenTempI = 0; screenTempI < 8; screenTempI++) {
    setPage(screenTempI);
    setColumn(0);
    for (screenTempI2 = 0; screenTempI2 < 128; screenTempI2++) {
      trans(DATA, logoArray[(screenTempI * 128) + screenTempI2]);
    }
  }
}

void displaycl() {
  for (screenTempI = 0; screenTempI < 8; screenTempI++) {
    setPage(screenTempI);
    setColumn(0);
    for (screenTempI2 = 0; screenTempI2 < 128; screenTempI2++) {
      trans(DATA, cl[(screenTempI * 128) + screenTempI2]);
    }
  }
}


void displayMainScreen() {
  //displayBattery();
  //displayDateTime();
  //displayAlarms();
  displayBig(3, "TOPLAM", CENTER);
  sprintf(displayArr, "DENEME");
  displayBig(6, displayArr, CENTER);
}

void displayMainScreen2() {
  displayBig(3, "KALAN", CENTER);
  sprintf(displayArr, "DENEME2");
  displayBig(6, displayArr, CENTER);
}

void getBatteryValues(){
  //BATARYAYI DENERKEN : https://forum.arduino.cc/t/measuring-the-battery-voltage-using-the-adc-on-mini-3v3-8mhz/422944   /   https://forum.arduino.cc/t/battery-level-check-using-arduino/424054  /  https://www.arduino.cc/reference/en/language/functions/analog-io/analogreference/

 /* const long InternalReferenceVoltage = 1062;  // Adjust this value to your board's specific internal BG voltage

// Code courtesy of "Coding Badly" and "Retrolefty" from the Arduino forum
// results are Vcc * 100
// So for example, 5V would be 500.
int getBandgap () 
  {
  // REFS0 : Selects AVcc external reference
  // MUX3 MUX2 MUX1 : Selects 1.1V (VBG)  
   ADMUX = bit (REFS0) | bit (MUX3) | bit (MUX2) | bit (MUX1);
   ADCSRA |= bit( ADSC );  // start conversion
   while (ADCSRA & bit (ADSC))
     { }  // wait for conversion to complete (toss this measurement)
   ADCSRA |= bit( ADSC );  // start conversion
   while (ADCSRA & bit (ADSC))
     { }  // wait for conversion to complete
   int results = (((InternalReferenceVoltage * 1024) / ADC) + 5) / 10; 
   return results;
  } // end of getBandgap */

//OR
/*
int value = 0;
float voltage;
float perc;

void setup(){
  Serial.begin(9600);
}

void loop(){
  value = analogRead(A0);
  voltage = value * 5.0/1023;
  perc = map(voltage, 3.6, 4.2, 0, 100);
  Serial.print("Voltage= ");
  Serial.println(voltage);
  Serial.print("Battery level= ");
  Serial.print(perc);
  Serial.println(" %");
  delay(500);
} 
 */

 

  
}

void displayBattery() {
 // getBatteryValues();
char DEVICEbattery1;
  DEVICEbattery1= '80';
  setPage(1);
  setColumn(98);
  sprintf(arr, "%02u", DEVICEbattery1);
 // displayChar(charArray[arr[1] - 32]);
 // displayChar(charArray[arr[0] - 32]);
  //displayChar(charArray['%' - 32]);
  trans(DATA, 0b00011100);
  trans(DATA, 0b00011100);
  trans(DATA, 0b01111111);
  trans(DATA, 0b01000001);
  if ( DEVICEbattery1 >= 83) {
    trans(DATA, 0b01011101);
  } else {
    trans(DATA, 0b01000001);
  }
  if ( DEVICEbattery1 >= 67) {
    trans(DATA, 0b01011101);
  } else {
    trans(DATA, 0b01000001);
  }
  if ( DEVICEbattery1 >= 50) {
    trans(DATA, 0b01011101);
  } else {
    trans(DATA, 0b01000001);
  }
  if ( DEVICEbattery1 >= 33) {
    trans(DATA, 0b01011101);
  } else {
    trans(DATA, 0b01000001);
  }
  if ( DEVICEbattery1 >= 17) {
    trans(DATA, 0b01011101);
  } else {
    trans(DATA, 0b01000001);
  }
  trans(DATA, 0b01011101);
  trans(DATA, 0b01000001);
  trans(DATA, 0b01111111);
}

void setup() {
  pinMode(SCREEN_CS_Pin, OUTPUT);
  pinMode(SCREEN_RST_Pin, OUTPUT);
  pinMode(SCREEN_A0_Pin, OUTPUT);
  pinMode(SCREEN_SCL_Pin, OUTPUT);
  pinMode(SCREEN_SDA_Pin, OUTPUT);
  initScreen();
 displayBattery();


}


void loop() {


}
